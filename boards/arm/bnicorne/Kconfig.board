## boards/arm/bnicorne/Kconfig.board
```kconfig
#
# Copyright (c) 2024 Kyle Brown
# SPDX-License-Identifier: MIT
#

config BOARD_BNICORNE_LEFT
    bool "bnicorne left"
    depends on SOC_NRF52840_QIAA

config BOARD_BNICORNE_RIGHT
    bool "bnicorne right"
    depends on SOC_NRF52840_QIAA
```
